## TestTimeDelay/main/Kconfig.projbuild
```kconfig
menu "### TestTON Example Configuration ###"


    choice EXAMPLE_TYPE
        prompt "Example Type"
        default EXAMPLE_TON
        help
            Select which Example to use.

        config EXAMPLE_AND
            bool "EXAMPLE_AND"
            
        config EXAMPLE_C_AND
            bool "EXAMPLE_C_AND"
            
        config EXAMPLE_OR
            bool "EXAMPLE_OR"
            
        config EXAMPLE_XOR
            bool "EXAMPLE_XOR"  
             
         config EXAMPLE_NOT
            bool "EXAMPLE_NOT"  
                       
        config EXAMPLE_TON
            bool "EXAMPLE_TON"

        config EXAMPLE_TOF
            bool "EXAMPLE_TOF"
            
        config EXAMPLE_TOF_R_TRIG_O
            bool "EXAMPLE_TOF_R_TRIG_O"
            
        config EXAMPLE_TRIG
            bool "EXAMPLE_TRIG"
            
        config EXAMPLE_BLINK
            bool "EXAMPLE_BLINK"
            
        config EXAMPLE_4_TON_SUPERTEST
        	bool "EXAMPLE 4 TON Supertest !"

        config THREE_POSITION_TOF
            bool "THREE_POSITION_TOF"
            
        config THREE_POSITION_TOF_Observed
            bool "THREE_POSITION_TOF_Observed"
            
        config THREE_POSITION_2TOF
            bool "THREE_POSITION_2TOF"
            
        config THREE_POSITION_2TOF_Observed
            bool "THREE_POSITION_2TOF_Observed"    
            
        config EXAMPLE_FOUR_POSITION_TOF
            bool "EXAMPLE_FOUR_POSITION_TOF"
            
        config EXAMPLE_FOUR_POSITION_TOF_Observed
            bool "EXAMPLE_FOUR_POSITION_TOF_Observed"
                            
        config EXAMPLE_FOUR_POSITION_3TOF
            bool "EXAMPLE_FOUR_POSITION_3TOF"
            
        config EXAMPLE_FOUR_POSITION_3TOF_Observed
            bool "EXAMPLE_FOUR_POSITION_3TOF_Observed"
                
                
    endchoice # EXAMPLE_TYPE

endmenu
```
